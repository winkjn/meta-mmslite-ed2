## conf/layer.conf
```bitbake
# We have a conf and classes directory, add to BBPATH
BBPATH .= ":${LAYERDIR}"

# We have recipes-* directories, add to BBFILES
BBFILES += "${LAYERDIR}/recipes-*/*/*.bb \
            ${LAYERDIR}/recipes-*/*/*.bbappend"

BBFILE_COLLECTIONS += "meta-mmslite-ed2"
BBFILE_PATTERN_meta-mmslite-ed2 = "^${LAYERDIR}/"
BBFILE_PRIORITY_meta-mmslite-ed2 = "6"

LAYERDEPENDS_meta-mmslite-ed2 = "core"
LAYERSERIES_COMPAT_meta-mmslite-ed2 = "dunfell"

# Append : johnkim
IMAGE_INSTALL_append += "hello mmslite-ed2 scl-srvr"
INSANE_SKIP_${PN} += "ldflags"
```
